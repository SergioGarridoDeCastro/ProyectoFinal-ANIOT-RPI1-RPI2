## components/mqtt/Kconfig.projbuild
```kconfig
menu "MQTT Configuration"
    config BROKER_URL
        string "Broker URL"
        default "mqtt.eclipseprojects.io"
        help
            URL of the broker to connect to

    config BROKER_URL_FROM_STDIN
        bool
        default y if BROKER_URL = "FROM_STDIN"
    
    config MQTT_PORT
        string "Port Mqtt"
        default "1883"
        help
            Port of the broker to connect to

    config TOPIC_SENSOR_TEMP
        string  "Topic monitoritation"
        default "nodo/sensor_temp"
        help 
            Topic del SENSOR_TEMP.
    
    config TOPIC_SENSOR_ECO2
        string  "Topic monitoritation"
        default "nodo/sensor_eco2"
        help 
            Topic del SENSOR_ECO2.        

    config TOPIC_SENSOR_TVOC
        string  "Topic monitoritation"
        default "nodo/sensor_eco2"
        help 
            Topic del SENSOR_TVOC.  

    config THINGSBOARD_PROVISION_DEVICE_KEY
        string "Device key para el provisionamiento via Thingsboard."
    
    config THINGSBOARD_PROVISION_DEVICE_SECRET
        string "Device secret para el provisionamiento via Thingsboard."

    config MQTT_USE_SECURE_VERSION
        bool "Use MQTTS"
        default n
        help
            Use MQTT over SSL

    config MQTT_USERNAME
        string "MQTT Username"
        default "mqtt_username"
        help
            Username to use in MQTT

    config MQTT_PASSWORD
        string "MQTT Password"
        default "mqtt_password"
        help
            Password to use in MQTT

    config MQTT_USE_LWT
        bool "Enable MQTT Last Will and Testament (LWT)"
        default n
        help
            Enable this option if you want to configure MQTT with Last Will and Testament.
    

    config LWT_TOPIC
        string  "LWT topic"
        default "nodo/lwt"
        help 
            Topic del mensaje LWT (Last Will and Testament).

    config LWT_MESSAGE
        string "LWT message"
        default "The node is desconnected"
        help
            Contenido del mensaje LWT.

    config LWT_RETAIN
        int "LWT Retain"
        default 1
        help
            Flag retain para el contenido del mensaje LWT

    config LWT_QOS
        int "LWT_QoS"
        default 1
        help 
            LWT message QoS
            
    config KEEPALIVE
        int "Keepalive"
        default 120
        help
            Valor del temporizador de keepalive

    config QOS_MQTT
        int "QoS"
        default 1
        help
            QoS de cada mensaje

    config RETAIN_MQTT
        int "Retain"
        default 1
        help
            Flag retain para el contenido del mensaje 

    config BROKER_CERTIFICATE_OVERRIDE
        string "Broker certificate override"
        default ""
        help
            Please leave empty if broker certificate included from a textfile; otherwise fill in a base64 part of PEM
            format certificate

    config BROKER_CERTIFICATE_OVERRIDDEN
        bool
        default y if BROKER_CERTIFICATE_OVERRIDE != ""

    config BROKER_BIN_SIZE_TO_SEND
        # This option is not visible and is used only to set parameters for example tests
        # Here we configure the data size to send and to be expected in the python script
        int
        default 20000

    config RECONNECT_TIMEOUT
        int 
        default 5
        help 
            Tiempo de reconexion
            
    config DEVICE_NAME
        string "Device Name"
        default ""
        help 
            Device name in ThingsBoard.

    config DEVICE_PROVISION_KEY
        string "Device Provision Key"
        default ""
        help 
            Provisioning device key, you should take it from configured device profile.

    config DEVICE_PROVISION_SECRET
        string "Device Provision Secret"
        default ""
        help 
            Provisioning device secret, you should take it from configured device profile.

    config ACCESS_TOKEN
        string "Access Token"
        default ""
        help 
            Credentials type parameter.
    
    config DEVICE_ACCESS_TOKEN
        string "Device Access Token"
        default ""
        help 
            Access token for device in ThingsBoard.
endmenu    
```

## components/muestradora/Kconfig.projbuild
```kconfig
menu 'Button_Configuration'
    config PERIOD_TEMPERATURE
        int "Number of SEC to wait until next read"
        default 1 
endmenu
```

## main/Kconfig.projbuild
```kconfig
menu "Project Configuration"
    config BROKER_URL
        string "Broker URL"
        default "mqtt://mqtt.eclipseprojects.io"
        help
            URL of the broker to connect to

    config BROKER_URL_FROM_STDIN
        bool
        default y if BROKER_URL = "FROM_STDIN"

    config MQTT_USERNAME
        string "MQTT Username"
        default "mqtt_username"
        help
            Username to use in MQTT

    config MQTT_PASSWORD
        string "MQTT Password"
        default "mqtt_password"
        help
            Password to use in MQTT

    config LWT_TOPIC
        string  "LWT topic"
        default "nodo/lwt"
        help 
            Topic del mensaje LWT (Last Will and Testament).

    config LWT_MESSAGE
        string "LWT message"
        default "The node is desconnected"
        help
            Contenido del mensaje LWT.

    config LWT_RETAIN
        int "LWT Retain"
        default 1
        help
            Flag retain para el contenido del mensaje LWT

    config LWT_QOS
        int "LWT_QoS"
        default 1
        help 
            LWT message QoS
            
    config KEEPALIVE
        int "Keepalive"
        default 120
        help
            Valor del temporizador de keepalive

    config QOS_MQTT
        int "QoS"
        default 1
        help
            QoS de cada mensaje


    config ESP_WIFI_SSID
        string "WiFi SSID"
        default "myssid"
        help
            SSID (network name) for the example to connect to.

    config ESP_WIFI_PASSWORD
        string "WiFi Password"
        default "mypassword"
        help
            WiFi password (WPA or WPA2) for the example to use.

    choice ESP_WIFI_SAE_MODE
        prompt "WPA3 SAE mode selection"
        default ESP_WPA3_SAE_PWE_BOTH
        help
            Select mode for SAE as Hunt and Peck, H2E or both.
        config ESP_WPA3_SAE_PWE_HUNT_AND_PECK
            bool "HUNT AND PECK"
        config ESP_WPA3_SAE_PWE_HASH_TO_ELEMENT
            bool "H2E"
        config ESP_WPA3_SAE_PWE_BOTH
            bool "BOTH"
    endchoice

    config ESP_WIFI_PW_ID
        string "PASSWORD IDENTIFIER"
        depends on  ESP_WPA3_SAE_PWE_HASH_TO_ELEMENT|| ESP_WPA3_SAE_PWE_BOTH
        default ""
        help
            password identifier for SAE H2E

    config ESP_MAXIMUM_RETRY
        int "Maximum retry"
        default 5
        help
            Set the Maximum retry to avoid reconnecting to an inexistent AP or if credentials
            are misconfigured. Provisioned credentials are erased and internal state machine
            is reset after this threshold is reached.

    config EXAMPLE_PROV_SHOW_QR
        bool "Show provisioning QR code"
        default y
        help
            Show the QR code for provisioning.

    config EXAMPLE_PROV_USING_BLUEDROID
        bool
        depends on (BT_BLUEDROID_ENABLED && (IDF_TARGET_ESP32C3 || IDF_TARGET_ESP32S3))
        select BT_BLE_42_FEATURES_SUPPORTED
        default y
        help
            This enables BLE 4.2 features for Bluedroid.
endmenu

menu "Transport Protocol"
    choice TRANSPORT_CONFIGURATION
        bool "Transport Protocol"
        default USE_MQTT_PROTOCOL if IDF_TARGET_ESP32S2
        default USE_COAP_PROTOCOL
        help
            Wi-Fi provisioning component offers both, SoftAP and BLE transports. Choose any one.

        config USE_MQTT_PROTOCOL
            bool "MQTT"
            select BT_ENABLED
            depends on !IDF_TARGET_ESP32S2
        config USE_COAP_PROTOCOL
            bool "COAP"
    endchoice
endmenu

menu "Provision Configuration"

    choice EXAMPLE_PROV_TRANSPORT
        bool "Provisioning Transport"
        default EXAMPLE_PROV_TRANSPORT_SOFTAP if IDF_TARGET_ESP32S2
        default EXAMPLE_PROV_TRANSPORT_BLE
        help
            Wi-Fi provisioning component offers both, SoftAP and BLE transports. Choose any one.

        config EXAMPLE_PROV_TRANSPORT_BLE
            bool "BLE"
            select BT_ENABLED
            depends on !IDF_TARGET_ESP32S2
        config EXAMPLE_PROV_TRANSPORT_SOFTAP
            bool "Soft AP"
            select LWIP_IPV4
    endchoice

    choice EXAMPLE_PROV_SECURITY_VERSION
        bool "Protocomm security version"
        default EXAMPLE_PROV_SECURITY_VERSION_2
        help
            Wi-Fi provisioning component offers 3 security versions.
            The example offers a 'opcion' between security version 1 and 2.

        config EXAMPLE_PROV_SECURITY_VERSION_1
            bool "Security version 1"
            select ESP_PROTOCOMM_SUPPORT_SECURITY_VERSION_1

        config EXAMPLE_PROV_SECURITY_VERSION_2
            bool "Security version 2"
            select ESP_PROTOCOMM_SUPPORT_SECURITY_VERSION_2
    endchoice

    choice EXAMPLE_PROV_MODE
        bool "Security version 2 mode"
        depends on EXAMPLE_PROV_SECURITY_VERSION_2
        default EXAMPLE_PROV_SEC2_DEV_MODE

        config EXAMPLE_PROV_SEC2_DEV_MODE
            bool "Security version 2 development mode"
            depends on EXAMPLE_PROV_SECURITY_VERSION_2
            help
                This enables the development mode for
                security version 2.
                Please note that this mode is NOT recommended for production purpose.

        config EXAMPLE_PROV_SEC2_PROD_MODE
            bool "Security version 2 production mode"
            depends on EXAMPLE_PROV_SECURITY_VERSION_2
            help
                This enables the production mode for
                security version 2.
    endchoice

    config EXAMPLE_PROV_TRANSPORT
        int
        default 1 if EXAMPLE_PROV_TRANSPORT_BLE
        default 2 if EXAMPLE_PROV_TRANSPORT_SOFTAP

    config EXAMPLE_RESET_PROVISIONED
        bool
        default n
        prompt "Reset provisioned status of the device"
        help
            This erases the NVS to reset provisioned status of the device on every reboot.
            Provisioned status is determined by the Wi-Fi STA configuration, saved on the NVS.

    config EXAMPLE_RESET_PROV_MGR_ON_FAILURE
        bool
        default y
        prompt "Reset provisioned credentials and state machine after session failure"
        help
            Enable reseting provisioned credentials and state machine after session failure.
            This will restart the provisioning service after retries are exhausted.

    config EXAMPLE_PROV_MGR_MAX_RETRY_CNT
        int
        default 5
        prompt "Max retries before reseting provisioning state machine"
        depends on EXAMPLE_RESET_PROV_MGR_ON_FAILURE
        help
            Set the Maximum retry to avoid reconnecting to an inexistent AP or if credentials
            are misconfigured. Provisioned credentials are erased and internal state machine
            is reset after this threshold is reached.

    config EXAMPLE_PROV_SHOW_QR
        bool "Show provisioning QR code"
        default y
        help
            Show the QR code for provisioning.

    config EXAMPLE_PROV_USING_BLUEDROID
        bool
        depends on (BT_BLUEDROID_ENABLED && (IDF_TARGET_ESP32C3 || IDF_TARGET_ESP32S3))
        select BT_BLE_42_FEATURES_SUPPORTED
        default y
        help
            This enables BLE 4.2 features for Bluedroid.

    config EXAMPLE_REPROVISIONING
        bool "Re-provisioning"
        help
            Enable re-provisioning - allow the device to provision for new credentials
            after previous successful provisioning.

endmenu
```
